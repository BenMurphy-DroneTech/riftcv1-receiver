## CMakeLists.txt
```
#
# Copyright (c) 2018 Nordic Semiconductor
#
# SPDX-License-Identifier: LicenseRef-Nordic-5-Clause
#
cmake_minimum_required(VERSION 3.20.0)

find_package(Zephyr REQUIRED HINTS $ENV{ZEPHYR_BASE})
project(NONE)

FILE(GLOB_RECURSE app_sources src/*.c)
# NORDIC SDK APP START
target_sources(app PRIVATE ${app_sources})
# NORDIC SDK APP END

target_include_directories(app PRIVATE src)

# riftcv1: the camera beacon, from riftcv1-mocap's firmware/rift_common (a west
# project beside nrf/), sharing the chip with ESB (RIFT_SHARED)
if(NOT DEFINED RIFT_COMMON)
  set(RIFT_COMMON ${ZEPHYR_BASE}/../riftcv1-mocap/firmware/rift_common)
endif()
target_include_directories(app PRIVATE ${RIFT_COMMON})
target_sources(app PRIVATE
  ${RIFT_COMMON}/beacon_tx.c
  ${RIFT_COMMON}/beacon_app.c
  ${RIFT_COMMON}/led_pulse.c)
target_compile_definitions(app PRIVATE RIFT_SHARED)

# riftcv1: the acknowledgement timestamps need a hook in ESB's PRX interrupt,
# so NCS's subsys/esb/esb.c is swapped for the patched copy in esb/
set(ESB_LIB ..__nrf__subsys__esb)
get_target_property(esb_sources ${ESB_LIB} SOURCES)
list(FILTER esb_sources EXCLUDE REGEX "(^|/)esb\\.c$")
set_property(TARGET ${ESB_LIB} PROPERTY SOURCES ${esb_sources} ${CMAKE_CURRENT_SOURCE_DIR}/esb/esb.c)
target_include_directories(${ESB_LIB} PRIVATE ${ZEPHYR_NRF_MODULE_DIR}/subsys/esb ${CMAKE_CURRENT_SOURCE_DIR}/src)

# Force recompile for updated build timestamp
add_custom_target(touch_util_h ALL
    COMMAND ${CMAKE_COMMAND} -E touch ${CMAKE_SOURCE_DIR}/src/build_defines.h
)
```

## Kconfig
```
#
# Copyright (c) 2020 Nordic Semiconductor
#
# SPDX-License-Identifier: LicenseRef-Nordic-5-Clause
#

config RIFT_FAST_RAMP_UP
    bool "ESB fast radio ramp-up"
    default y
    help
      40 us radio ramp-ups in place of about 130 us, for the band packet
      timing plan's sub-slots. The bands have to be built the same way.

choice
	prompt "Status LED color mapping"
    default LED_TRI_COLOR

config LED_RGB_COLOR
    bool "Use RGB color mapping"
    help
        Use RGB or RG color mapping for LED status if available.

config LED_TRI_COLOR
    bool "Use default color mapping"
    help
        Use the default color mapping for LED status.

endchoice

menu "Status LED default status color"
    depends on LED_RGB_COLOR

config LED_DEFAULT_COLOR_R
    int "Red value"
    range 0 10000
    default 4000
    depends on LED_RGB_COLOR
    help
        Red color for default status.
        Valid range is 0 to 10000.

config LED_DEFAULT_COLOR_G
    int "Green value"
    range 0 10000
    default 6000
    depends on LED_RGB_COLOR
    help
        Green color for default status.
        Valid range is 0 to 10000.

config LED_DEFAULT_COLOR_B
    int "Blue value"
    range 0 10000
    default 0
    depends on LED_RGB_COLOR
    help
        Blue color for default status.
        Valid range is 0 to 10000.

endmenu

source "Kconfig.zephyr"
```

## west.yml
```
manifest:
  version: "1.2"
  projects:

    # nRF-Connect SDK
    - name: sdk-nrf
      path: nrf
      url: https://github.com/nrfconnect/sdk-nrf.git
      revision: v3.3.0-preview3-branch
      import: true

    # riftcv1-mocap: the camera beacon (firmware/rift_common)
    - name: riftcv1-mocap
      path: riftcv1-mocap
      url: https://github.com/BenMurphy-DroneTech/riftcv1-mocap.git
      revision: 840c3045461acf02f286f11f167deca0a41dfc0f
```

## prj.conf
```kconfig
#CONFIG_NCS_SAMPLES_DEFAULTS
CONFIG_ASSERT=y
CONFIG_ASSERT_NO_COND_INFO=y
CONFIG_ASSERT_NO_MSG_INFO=y
CONFIG_RESET_ON_FATAL_ERROR=y

CONFIG_NCS_APPLICATION_BOOT_BANNER_STRING="SlimeVR-Tracker-nRF-Receiver"
#CONFIG_NCS_BOOT_BANNER=n
CONFIG_BOOT_BANNER=n

CONFIG_ESB=y
CONFIG_NEWLIB_LIBC=y
CONFIG_CBPRINTF_FP_SUPPORT=y

CONFIG_FPU=y

CONFIG_USB_DEVICE_STACK=y
CONFIG_USB_DEVICE_HID=y
CONFIG_USB_DEVICE_VID=0x1209
CONFIG_USB_DEVICE_PID=0x7690
CONFIG_USB_HID_BOOT_PROTOCOL=y
CONFIG_USB_DEVICE_INITIALIZE_AT_BOOT=n
CONFIG_USB_CDC_ACM=y
CONFIG_UART_INTERRUPT_DRIVEN=y
#CONFIG_USB_WORKQUEUE_STACK_SIZE=512

CONFIG_SERIAL=y
CONFIG_CONSOLE=y
CONFIG_UART_CONSOLE=y
CONFIG_UART_LINE_CTRL=y

CONFIG_USE_SEGGER_RTT=y
CONFIG_LOG=y
#CONFIG_PRINTK=y
CONFIG_LOG_MODE_DEFERRED=y
CONFIG_LOG_SPEED=y
CONFIG_LOG_BACKEND_RTT=y
CONFIG_USB_DRIVER_LOG_LEVEL_WRN=y
CONFIG_USB_DEVICE_LOG_LEVEL_WRN=y
CONFIG_USB_CDC_ACM_LOG_LEVEL_OFF=y
CONFIG_LOG_PROCESS_THREAD_SLEEP_MS=100
CONFIG_LOG_PROCESS_THREAD_STACK_SIZE=1024
CONFIG_LOG_PROCESS_THREAD_STARTUP_DELAY_MS=0

CONFIG_LOG_BACKEND_UART=y
CONFIG_LOG_MODE_DEFERRED=y

CONFIG_CONSOLE_SUBSYS=y
CONFIG_CONSOLE_GETLINE=y

CONFIG_NVS_LOG_LEVEL_WRN=y
CONFIG_USB_HID_LOG_LEVEL_WRN=y

CONFIG_USB_DEVICE_SOF=y
CONFIG_USB_HID_REPORTS=256

CONFIG_USB_HID_POLL_INTERVAL_MS=1
CONFIG_HID_INTERRUPT_EP_MPS=64
CONFIG_ENABLE_HID_INT_OUT_EP=y

CONFIG_GPIO=y
CONFIG_PWM=y

CONFIG_NVS=y

CONFIG_FLASH=y
CONFIG_FLASH_PAGE_LAYOUT=y
CONFIG_FLASH_MAP=y

CONFIG_SETTINGS=y
CONFIG_SETTINGS_NVS=y
CONFIG_SETTINGS_RUNTIME=y
CONFIG_SETTINGS_NONE=y

CONFIG_MPU_ALLOW_FLASH_WRITE=y

CONFIG_NVS_LOOKUP_CACHE=y

CONFIG_ESB_TX_FIFO_SIZE=1
# riftcv1: TIMER2 is the camera beacon's clock (rift_common), so ESB takes TIMER1
CONFIG_ESB_SYS_TIMER1=y
# deprecated?
#CONFIG_NRFX_TIMER1=y

#speed up boot? (use internal rc oscillator)
#CONFIG_CLOCK_CONTROL_NRF_K32SRC_RC=y
#speed up boot? (synthesize lf clock)
CONFIG_CLOCK_CONTROL_NRF_K32SRC_SYNTH=y

# dont need it
CONFIG_CRYPTO=n

CONFIG_THREAD_NAME=y
#CONFIG_SYSTEM_WORKQUEUE_STACK_SIZE=256
CONFIG_MAIN_STACK_SIZE=512

#CONFIG_HEAP_MEM_POOL_SIZE=2048
CONFIG_ISR_STACK_SIZE=1024

# riftcv1: ESB's radio interrupt above the default peripheral priority (1), so its
# handler always runs within the 40 us of a fast ramp-up (RIFT_FAST_RAMP_UP)
CONFIG_ESB_RADIO_IRQ_PRIORITY=0
```

## boards/xiao_ble.conf
```kconfig
CONFIG_USB_DEVICE_MANUFACTURER="Seeed Studio"
CONFIG_USB_DEVICE_PRODUCT="SlimeNRF Receiver XIAO"

CONFIG_LED_RGB_COLOR=y

# The board defaults to the new USB stack for its console; the receiver uses the legacy stack
CONFIG_BOARD_SERIAL_BACKEND_CDC_ACM=n
CONFIG_USB_DEVICE_STACK_NEXT=n

# riftcv1-band's 36-byte frame packets
CONFIG_ESB_MAX_PAYLOAD_LENGTH=40

# rift_imu_rx prints about 90 IMU lines a second: room for them in the log and the USB buffers
CONFIG_LOG_BUFFER_SIZE=8192
CONFIG_LOG_PROCESS_THREAD_SLEEP_MS=10
CONFIG_USB_CDC_ACM_RINGBUF_SIZE=4096
```

## src/main.c
```c
/*
	SlimeVR Code is placed under the MIT license
	Copyright (c) 2025 SlimeVR Contributors

	Permission is hereby granted, free of charge, to any person obtaining a copy
	of this software and associated documentation files (the "Software"), to deal
	in the Software without restriction, including without limitation the rights
	to use, copy, modify, merge, publish, distribute, sublicense, and/or sell
	copies of the Software, and to permit persons to whom the Software is
	furnished to do so, subject to the following conditions:

	The above copyright notice and this permission notice shall be included in
	all copies or substantial portions of the Software.

	THE SOFTWARE IS PROVIDED "AS IS", WITHOUT WARRANTY OF ANY KIND, EXPRESS OR
	IMPLIED, INCLUDING BUT NOT LIMITED TO THE WARRANTIES OF MERCHANTABILITY,
	FITNESS FOR A PARTICULAR PURPOSE AND NONINFRINGEMENT. IN NO EVENT SHALL THE
	AUTHORS OR COPYRIGHT HOLDERS BE LIABLE FOR ANY CLAIM, DAMAGES OR OTHER
	LIABILITY, WHETHER IN AN ACTION OF CONTRACT, TORT OR OTHERWISE, ARISING FROM,
	OUT OF OR IN CONNECTION WITH THE SOFTWARE OR THE USE OR OTHER DEALINGS IN
	THE SOFTWARE.
*/
#include "globals.h"
#include "system/system.h"
#include "rift/rift.h"

#include <zephyr/kernel.h>

LOG_MODULE_REGISTER(main, LOG_LEVEL_INF);

int main(void)
{
	rift_init(); // the camera beacon, before ESB starts
	set_led(SYS_LED_PATTERN_ACTIVE_PERSIST, SYS_LED_PRIORITY_SYSTEM);

	return 0;
}
```

## src/console.c
```c
/*
	SlimeVR Code is placed under the MIT license
	Copyright (c) 2025 SlimeVR Contributors

	Permission is hereby granted, free of charge, to any person obtaining a copy
	of this software and associated documentation files (the "Software"), to deal
	in the Software without restriction, including without limitation the rights
	to use, copy, modify, merge, publish, distribute, sublicense, and/or sell
	copies of the Software, and to permit persons to whom the Software is
	furnished to do so, subject to the following conditions:

	The above copyright notice and this permission notice shall be included in
	all copies or substantial portions of the Software.

	THE SOFTWARE IS PROVIDED "AS IS", WITHOUT WARRANTY OF ANY KIND, EXPRESS OR
	IMPLIED, INCLUDING BUT NOT LIMITED TO THE WARRANTIES OF MERCHANTABILITY,
	FITNESS FOR A PARTICULAR PURPOSE AND NONINFRINGEMENT. IN NO EVENT SHALL THE
	AUTHORS OR COPYRIGHT HOLDERS BE LIABLE FOR ANY CLAIM, DAMAGES OR OTHER
	LIABILITY, WHETHER IN AN ACTION OF CONTRACT, TORT OR OTHERWISE, ARISING FROM,
	OUT OF OR IN CONNECTION WITH THE SOFTWARE OR THE USE OR OTHER DEALINGS IN
	THE SOFTWARE.
*/
#include "globals.h"
#include "system/system.h"
#include "build_defines.h"
#include "parse_args.h"

#define USB DT_NODELABEL(usbd)
#if DT_NODE_HAS_STATUS(USB, okay)

#include <zephyr/drivers/gpio.h>
#include <zephyr/console/console.h>
#include <zephyr/sys/reboot.h>
#include <zephyr/logging/log_ctrl.h>
#include "connection/esb.h"
#include "rift/rift.h"

#include <ctype.h>

#define DFU_DBL_RESET_MEM 0x20007F7C
#define DFU_DBL_RESET_APP 0x4ee5677e

uint32_t* dbl_reset_mem = ((uint32_t*) DFU_DBL_RESET_MEM);

LOG_MODULE_REGISTER(console, LOG_LEVEL_INF);

static void console_thread(void);
K_THREAD_DEFINE(console_thread_id, 1024, console_thread, NULL, NULL, NULL, 6, 0, 0);

#define DFU_EXISTS CONFIG_BUILD_OUTPUT_UF2 || CONFIG_BOARD_HAS_NRF5_BOOTLOADER
#define ADAFRUIT_BOOTLOADER CONFIG_BUILD_OUTPUT_UF2
#define NRF5_BOOTLOADER CONFIG_BOARD_HAS_NRF5_BOOTLOADER

#if NRF5_BOOTLOADER
static const struct device *gpio_dev = DEVICE_DT_GET(DT_NODELABEL(gpio0));
#endif

static const char *meows[] = {
	"Mew",
	"Meww",
	"Meow",
	"Meow meow",
	"Mrrrp",
	"Mrrf",
	"Mreow",
	"Mrrrow",
	"Mrrr",
	"Purr",
	"mew",
	"meww",
	"meow",
	"meow meow",
	"mrrrp",
	"mrrf",
	"mreow",
	"mrrrow",
	"mrrr",
	"purr",
};

static const char *meow_punctuations[] = {
	".",
	"?",
	"!",
	"-",
	"~",
	""
};

static const char *meow_suffixes[] = {
	" :3",
	" :3c",
	" ;3",
	" ;3c",
	" x3",
	" x3c",
	" X3",
	" X3c",
	" >:3",
	" >:3c",
	" >;3",
	" >;3c",
	""
};

static void skip_dfu(void)
{
#if DFU_EXISTS // Using Adafruit bootloader
	(*dbl_reset_mem) = DFU_DBL_RESET_APP; // Skip DFU
	ram_range_retain(dbl_reset_mem, sizeof(dbl_reset_mem), true);
#endif
}

static void print_info(void)
{
	printk(CONFIG_USB_DEVICE_MANUFACTURER " " CONFIG_USB_DEVICE_PRODUCT "\n");
	printk(FW_STRING);

	printk("\nBoard: " CONFIG_BOARD "\n");
	printk("SOC: " CONFIG_SOC "\n");
	printk("Target: " CONFIG_BOARD_TARGET "\n");

	printk("\nDevice address: %012llX\n", *(uint64_t *)NRF_FICR->DEVICEADDR & 0xFFFFFFFFFFFF);
}

static void print_uptime(void)
{
	int64_t uptime = k_ticks_to_us_floor64(k_uptime_ticks());

	uint32_t days = uptime / 86400000000;
	uptime %= 86400000000;
	uint8_t hours = uptime / 3600000000;
	uptime %= 3600000000;
	uint8_t minutes = uptime / 60000000;
	uptime %= 60000000;
	uint8_t seconds = uptime / 1000000;
	uptime %= 1000000;
	uint16_t milliseconds = uptime / 1000;
	uint16_t microseconds = uptime %= 1000;

	printk("Uptime: %u.%02u:%02u:%02u.%03u,%03u\n", days, hours, minutes, seconds, milliseconds, microseconds);
}

static void print_meow(void)
{
	int64_t ticks = k_uptime_ticks();

	ticks %= ARRAY_SIZE(meows) * ARRAY_SIZE(meow_punctuations) * ARRAY_SIZE(meow_suffixes); // silly number generator
	uint8_t meow = ticks / (ARRAY_SIZE(meow_punctuations) * ARRAY_SIZE(meow_suffixes));
	ticks %= (ARRAY_SIZE(meow_punctuations) * ARRAY_SIZE(meow_suffixes));
	uint8_t punctuation = ticks / ARRAY_SIZE(meow_suffixes);
	uint8_t suffix = ticks % ARRAY_SIZE(meow_suffixes);

	printk("%s%s%s\n", meows[meow], meow_punctuations[punctuation], meow_suffixes[suffix]);
}

static void print_list(void)
{
	printk("Stored devices:\n");
	for (uint8_t i = 0; i < stored_trackers; i++)
		printk("%012llX\n", stored_tracker_addr[i]);
}

static inline void strtolower(char *str) {
	for(int i = 0; str[i]; i++) {
		str[i] = tolower(str[i]);
	}
}

static void print_help(void)
{
	printk("\nhelp                         Display this help text\n");

	printk("\ninfo                         Get device information\n");
	printk("uptime                       Get device uptime\n");
	printk("list                         Get paired devices\n");
	printk("stats                        Get packet rate and loss since the last stats\n");
	printk("reboot                      Soft reset the device\n");
	printk("\nadd <address>                Manually add a device\n");
	printk("remove                       Remove last device\n");
	printk("pair                         Enter pairing mode\n");
	printk("exit                         Exit pairing mode\n");
	printk("clear                        Clear stored devices\n");
#if DFU_EXISTS
	printk("\ndfu                          Enter DFU bootloader\n");
#endif
	printk("\nmeow                         Meow!\n");

	printk("\nCamera beacon: <us>, <fps>fps, +, -, step <us>, width <us>, off <us>, led on|off, ?,\n");
	printk("sweep [step [start [count]]]|off, wrap [s], pause [ms], addr [hex]; stats includes it\n");
}

static void console_thread(void)
{
	console_getline_init();
	while (log_data_pending())
		k_usleep(1);
	k_msleep(100);
	printk("*** " CONFIG_USB_DEVICE_MANUFACTURER " " CONFIG_USB_DEVICE_PRODUCT " ***\n");
	printk(FW_STRING);
	print_help();

	const char command_help[] = "help";

	const char command_info[] = "info";
	const char command_uptime[] = "uptime";
	const char command_list[] = "list";
	const char command_stats[] = "stats";
	const char command_reboot[] = "reboot";
	const char command_add[] = "add";
	const char command_remove[] = "remove";
	const char command_pair[] = "pair";
	const char command_exit[] = "exit";
	const char command_clear[] = "clear";
#if DFU_EXISTS
	const char command_dfu[] = "dfu";
#endif
	const char command_meow[] = "meow";

	while (1) {
		char *line = console_getline();
		char raw[CONFIG_CONSOLE_INPUT_MAX_LINE_LEN];

		strncpy(raw, line, sizeof(raw) - 1); // the whole line, for the beacon commands
		raw[sizeof(raw) - 1] = '\0';

		char* argv[5] = {NULL}; // command and 4 args
		size_t argc = parse_args(line, argv, ARRAY_SIZE(argv));
		if(argc == 0)
			continue;
		if(argc > 0)
			strtolower(argv[0]); // lower case the command
		if(argc > 1)
			strtolower(argv[1]); // lower case the first argument
		// only care that the first words are matchable

		if (strcmp(argv[0], command_help) == 0)
		{
			print_help();
		}
		else if (strcmp(argv[0], command_info) == 0)
		{
			print_info();
		}
		else if (strcmp(line, command_uptime) == 0)
		{
			print_uptime();
		}
		else if (strcmp(line, command_add) == 0)
		{
			if (argc != 2)
			{
				printk("Invalid number of arguments\n");
				continue;
			}
			uint64_t addr = parse_u64(argv[1], 16);
			uint8_t buf[13];
			snprintk(buf, 13, "%012llx", addr);
			if (addr != 0 && strcmp(buf, argv[1]) == 0)
				esb_add_pair(addr, true);
			else
				printk("Invalid address\n");
		}
		else if (strcmp(line, command_remove) == 0)
		{
			esb_pop_pair();
		}
		else if (strcmp(line, command_list) == 0)
		{
			print_list();
		}
		else if (strcmp(line, command_stats) == 0)
		{
			esb_print_stats();
			rift_print_stats();
			rift_imu_print_stats();
		}
		else if (strcmp(line, command_reboot) == 0)
		{
			skip_dfu();
			sys_reboot(SYS_REBOOT_COLD);
		}
		else if (strcmp(line, command_pair) == 0)
		{
			esb_reset_pair();
		}
		else if (strcmp(line, command_exit) == 0)
		{
			esb_finish_pair();
		}
		else if (strcmp(line, command_clear) == 0)
		{
			esb_clear();
		}
#if DFU_EXISTS
		else if (strcmp(line, command_dfu) == 0)
		{
#if ADAFRUIT_BOOTLOADER
			NRF_POWER->GPREGRET = 0x57;
			sys_reboot(SYS_REBOOT_COLD);
#endif
#if NRF5_BOOTLOADER
			gpio_pin_configure(gpio_dev, 19, GPIO_OUTPUT | GPIO_OUTPUT_INIT_LOW);
#endif
		}
#endif
		else if (strcmp(line, command_meow) == 0)
		{
			print_meow();
		}
		else
		{
			rift_command(raw); // the camera beacon's commands
		}
	}
}

#endif
```
